#include "wren.dtsi" // The shared dtsi file is included in the overlay

// Label of the kscan node in the dtsi
&kscan0 {
    col-gpios
            = <&pro_micro10 GPIO_ACTIVE_HIGH>
            , <&pro_micro16 GPIO_ACTIVE_HIGH>
            , <&pro_micro14 GPIO_ACTIVE_HIGH>
            , <&pro_micro15 GPIO_ACTIVE_HIGH>
            , <&pro_micro18 GPIO_ACTIVE_HIGH>
            , <&pro_micro19 GPIO_ACTIVE_HIGH>
            ;
};